## config/boards/shields/zilpzalp_ble/Kconfig.defconfig
```kconfig
# Copyright (c) 2022 The ZMK Contributors
# SPDX-License-Identifier: MIT

if SHIELD_ZILPZALP_BLE

config ZMK_KEYBOARD_NAME
    default "zilpzalp_ble"

endif
```

## config/boards/shields/zilpzalp_ble/Kconfig.shield
```kconfig
# Copyright (c) 2022 The ZMK Contributors
# SPDX-License-Identifier: MIT

config SHIELD_ZILPZALP_BLE
    def_bool $(shields_list_contains,zilpzalp_ble)
```

## config/west.yml
```yaml
manifest:
  remotes:
    - name: zmkfirmware
      url-base: https://github.com/zmkfirmware
    - name: kilipan
      url-base: https://github.com/kilipan
  projects:
    - name: zmk
      remote: zmkfirmware
      revision: main
      import: app/west.yml
    - name: zmk-keyboards-zilpzalp
      remote: kilipan
      revision: main
  self:
    path: config
```
